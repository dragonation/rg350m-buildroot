## arch/Config.in
```kconfig
menu "Target options"

config BR2_ARCH_IS_64
	bool

config BR2_KERNEL_64_USERLAND_32
	bool

config BR2_SOFT_FLOAT
	bool

config BR2_ARCH_HAS_MMU_MANDATORY
	bool

config BR2_ARCH_HAS_MMU_OPTIONAL
	bool

choice
	prompt "Target Architecture"
	default BR2_mipsel
	help
	  Select the target architecture family to build for.

config BR2_mipsel
	bool "MIPS (little endian)"
	select BR2_ARCH_HAS_MMU_MANDATORY
	help
	  MIPS is a RISC microprocessor from MIPS Technologies. Little
	  endian.
	  http://www.mips.com/
	  http://en.wikipedia.org/wiki/MIPS_Technologies

endchoice

# For some architectures or specific cores, our internal toolchain
# backend is not suitable (like, missing support in upstream gcc, or
# no ChipCo fork exists...)
config BR2_ARCH_HAS_NO_TOOLCHAIN_BUILDROOT
	bool

config BR2_ARCH_HAS_TOOLCHAIN_BUILDROOT
	bool
	default y if !BR2_ARCH_HAS_NO_TOOLCHAIN_BUILDROOT

# The following symbols are selected by the individual
# Config.in.$ARCH files
config BR2_ARCH_NEEDS_GCC_AT_LEAST_4_8
	bool

config BR2_ARCH_NEEDS_GCC_AT_LEAST_4_9
	bool
	select BR2_ARCH_NEEDS_GCC_AT_LEAST_4_8

config BR2_ARCH_NEEDS_GCC_AT_LEAST_5
	bool
	select BR2_ARCH_NEEDS_GCC_AT_LEAST_4_9

config BR2_ARCH_NEEDS_GCC_AT_LEAST_6
	bool
	select BR2_ARCH_NEEDS_GCC_AT_LEAST_5

config BR2_ARCH_NEEDS_GCC_AT_LEAST_7
	bool
	select BR2_ARCH_NEEDS_GCC_AT_LEAST_6

config BR2_ARCH_NEEDS_GCC_AT_LEAST_8
	bool
	select BR2_ARCH_NEEDS_GCC_AT_LEAST_7

config BR2_ARCH_NEEDS_GCC_AT_LEAST_9
	bool
	select BR2_ARCH_NEEDS_GCC_AT_LEAST_8

config BR2_ARCH_NEEDS_GCC_AT_LEAST_10
	bool
	select BR2_ARCH_NEEDS_GCC_AT_LEAST_9

# The following string values are defined by the individual
# Config.in.$ARCH files
config BR2_ARCH
	string

config BR2_ENDIAN
	string

config BR2_GCC_TARGET_ARCH
	string

config BR2_GCC_TARGET_ABI
	string

config BR2_GCC_TARGET_NAN
	string

config BR2_GCC_TARGET_FP32_MODE
	string

config BR2_GCC_TARGET_CPU
	string

# The value of this option will be passed as --with-fpu=<value> when
# building gcc (internal backend) or -mfpu=<value> in the toolchain
# wrapper (external toolchain)
config BR2_GCC_TARGET_FPU
	string

# The value of this option will be passed as --with-float=<value> when
# building gcc (internal backend) or -mfloat-abi=<value> in the toolchain
# wrapper (external toolchain)
config BR2_GCC_TARGET_FLOAT_ABI
	string

# The value of this option will be passed as --with-mode=<value> when
# building gcc (internal backend) or -m<value> in the toolchain
# wrapper (external toolchain)
config BR2_GCC_TARGET_MODE
	string

# Must be selected by binary formats that support shared libraries.
config BR2_BINFMT_SUPPORTS_SHARED
	bool

# Must match the name of the architecture from readelf point of view,
# i.e the "Machine:" field of readelf output. See get_machine_name()
# in binutils/readelf.c for the list of possible values.
config BR2_READELF_ARCH_NAME
	string

# Set up target binary format
choice
	prompt "Target Binary Format"
	default BR2_BINFMT_ELF if BR2_USE_MMU
	default BR2_BINFMT_FLAT

config BR2_BINFMT_ELF
	bool "ELF"
	depends on BR2_USE_MMU
	select BR2_BINFMT_SUPPORTS_SHARED
	help
	  ELF (Executable and Linkable Format) is a format for libraries
	  and executables used across different architectures and
	  operating systems.

config BR2_BINFMT_FLAT
	bool "FLAT"
	depends on !BR2_USE_MMU
	help
	  FLAT binary is a relatively simple and lightweight executable
	  format based on the original a.out format. It is widely used
	  in environment where no MMU is available.

endchoice

# Set up flat binary type
choice
	prompt "FLAT Binary type"
	default BR2_BINFMT_FLAT_ONE
	depends on BR2_BINFMT_FLAT

config BR2_BINFMT_FLAT_ONE
	bool "One memory region"
	help
	  All segments are linked into one memory region.

config BR2_BINFMT_FLAT_SHARED
	bool "Shared binary"
	depends on BR2_m68k
	# Even though this really generates shared binaries, there is no libdl
	# and dlopen() cannot be used. So packages that require shared
	# libraries cannot be built. Therefore, we don't select
	# BR2_BINFMT_SUPPORTS_SHARED and therefore force BR2_STATIC_LIBS.
	# Although this adds -static to the compilation, that's not a problem
	# because the -mid-shared-library option overrides it.
	help
	  Allow to load and link indiviual FLAT binaries at run time.

endchoice

if BR2_mips || BR2_mips64 || BR2_mipsel || BR2_mips64el
source "arch/Config.in.mips"
endif

endmenu # Target options
```

## board/rg350m/Config.in
```kconfig
config BR2_TARGET_PLATFORM
	string "Target platform"
	help
	  Target platform, e.g. anbernic.
config BR2_TARGET_DEVICE
	string "Target device"
	help
	  Target device, e.g. rg350m.

menu "RG350M packages"
comment "Frontends"
	source "$BR2_EXTERNAL_RG350M_PATH/package/gmenu2x/Config.in"

comment "Libraries"
	source "$BR2_EXTERNAL_RG350M_PATH/package/allegro/Config.in"
	source "$BR2_EXTERNAL_RG350M_PATH/package/bennugd/Config.in"
	source "$BR2_EXTERNAL_RG350M_PATH/package/devil/Config.in"
	source "$BR2_EXTERNAL_RG350M_PATH/package/fluidsynth1/Config.in"
	source "$BR2_EXTERNAL_RG350M_PATH/package/libjpeg8/Config.in"
	source "$BR2_EXTERNAL_RG350M_PATH/package/libini/Config.in"
	source "$BR2_EXTERNAL_RG350M_PATH/package/libopk/Config.in"
	source "$BR2_EXTERNAL_RG350M_PATH/package/libpng14/Config.in"
	source "$BR2_EXTERNAL_RG350M_PATH/package/libshake/Config.in"
	source "$BR2_EXTERNAL_RG350M_PATH/package/libxdgmime/Config.in"
	source "$BR2_EXTERNAL_RG350M_PATH/package/love2d/Config.in"
	source "$BR2_EXTERNAL_RG350M_PATH/package/utf8cpp/Config.in"

comment "System tools"
	source "$BR2_EXTERNAL_RG350M_PATH/package/od-passwd-config/Config.in"
	source "$BR2_EXTERNAL_RG350M_PATH/package/pwswd/Config.in"

comment "Utilities"
	source "$BR2_EXTERNAL_RG350M_PATH/package/bar/Config.in"

comment "Graphics drivers"
	source "$BR2_EXTERNAL_RG350M_PATH/package/etna_viv/Config.in"
	source "$BR2_EXTERNAL_RG350M_PATH/package/mesa3d-etna_viv/Config.in"

comment "Hardware handling"
	source "$BR2_EXTERNAL_RG350M_PATH/package/lowpowd/Config.in"
	source "$BR2_EXTERNAL_RG350M_PATH/package/unlockvt/Config.in"

endmenu
```

## configs/rg350m_kernel_defconfig
```kconfig
# Architecture
BR2_mipsel=y
BR2_mips_xburst=y

# Target
BR2_TARGET_PLATFORM="anbernic"
BR2_TARGET_DEVICE="rg350m"

# Flags
BR2_MIPS_FP32_MODE_32=y
BR2_MIPS_SOFT_FLOAT=n
BR2_OPTIMIZE_2=y

# Buildroot
BR2_TOOLCHAIN_BUILDROOT_VENDOR="anbernic"
BR2_TOOLCHAIN_BUILDROOT_LARGEFILE=y
BR2_TOOLCHAIN_BUILDROOT_INET_IPV6=y
BR2_TOOLCHAIN_BUILDROOT_WCHAR=y

# Kernel
BR2_KERNEL_HEADERS_3_12=y
BR2_LINUX_KERNEL=y
BR2_LINUX_KERNEL_CUSTOM_TARBALL=y
BR2_LINUX_KERNEL_CUSTOM_TARBALL_LOCATION="https://github.com/tonyjih/RG350_linux/archive/b713e4eaaba4.tar.gz"
BR2_LINUX_KERNEL_USE_DEFCONFIG=y
BR2_LINUX_KERNEL_DEFCONFIG="rg350m"
BR2_LINUX_KERNEL_VMLINUZ_BIN=y

# Toolchain: [gcc]
BR2_GCC_VERSION_4_9_X=y
BR2_GCC_ENABLE_LTO=y

# Toolchain: [uclibc]
BR2_UCLIBC_CONFIG="board/rg350m/config/uclibc_defconfig"

# Tool kit: [busybox]
BR2_PACKAGE_BUSYBOX_CONFIG="board/rg350m/config/busybox_defconfig"
BR2_PACKAGE_BUSYBOX_SHOW_OTHERS=y

# Skeleton
BR2_ROOTFS_SKELETON_CUSTOM=y
BR2_ROOTFS_SKELETON_CUSTOM_PATH="board/rg350m/skeleton"
```

## configs/rg350m_userland_defconfig
```kconfig
# Architecture
BR2_mipsel=y
BR2_mips_xburst=y

# Target
BR2_TARGET_PLATFORM="anbernic"
BR2_TARGET_DEVICE="rg350m"
BR2_TARGET_GENERIC_HOSTNAME="rg350m"
BR2_TARGET_GENERIC_ISSUE="Welcome to RG350M"
BR2_TARGET_TZ_INFO=y
BR2_TARGET_LOCALTIME="Asia/Shanghai"

# Flags
BR2_MIPS_FP32_MODE_32=y
BR2_MIPS_SOFT_FLOAT=n
BR2_OPTIMIZE_2=y

# Buildroot
BR2_TOOLCHAIN_BUILDROOT_CXX=y
BR2_TOOLCHAIN_BUILDROOT_VENDOR="anbernic"
BR2_TOOLCHAIN_BUILDROOT_LARGEFILE=y
BR2_TOOLCHAIN_BUILDROOT_INET_IPV6=y
BR2_TOOLCHAIN_BUILDROOT_WCHAR=y

# Toolchain: [uclibc]
BR2_UCLIBC_CONFIG="board/rg350m/config/uclibc_defconfig"

# Toolchain: [binutils]
BR2_BINUTILS_VERSION_2_34_X=y
BR2_BINUTILS_ENABLE_LTO=y
BR2_PACKAGE_BINUTILS_TARGET=y

# Toolchain: [gcc]
BR2_GCC_VERSION_10_X=y
BR2_GCC_ENABLE_GRAPHITE=y
BR2_GCC_ENABLE_LTO=y
BR2_EXTRA_GCC_CONFIG_OPTIONS="--with-mips-plt"

# Toolchain: [gdb]
BR2_PACKAGE_GDB=y
BR2_PACKAGE_GDB_SERVER=y
BR2_PACKAGE_GDB_DEBUGGER=y
BR2_PACKAGE_HOST_GDB=y

# Kernel
BR2_KERNEL_HEADERS_3_12=y

# Firmware
BR2_PACKAGE_LINUX_FIRMWARE=y
BR2_PACKAGE_LINUX_FIRMWARE_RTL_81XX=y

# Bootloader
BR2_TARGET_UBIBOOT=y
BR2_TARGET_UBIBOOT_BOARDNAME="gcw0"

# System
BR2_SYSTEM_DEFAULT_PATH="/usr/bin:/usr/sbin"
BR2_SYSTEM_ENABLE_NLS=y

# Root FS
BR2_TARGET_ROOTFS_SQUASHFS=y
BR2_ROOTFS_DEVICE_CREATION_DYNAMIC_EUDEV=y
BR2_ROOTFS_SKELETON_CUSTOM=y
BR2_ROOTFS_SKELETON_CUSTOM_PATH="board/rg350m/skeleton"
BR2_ROOTFS_MERGED_USR=y
BR2_ROOTFS_OVERLAY="board/rg350m/overlay"
BR2_ROOTFS_POST_BUILD_SCRIPT="board/rg350m/hook/post-build-script.sh"

# Tool kit: [busybox]
BR2_PACKAGE_BUSYBOX_CONFIG="board/rg350m/config/busybox_defconfig"
BR2_PACKAGE_BUSYBOX_SHOW_OTHERS=y

# Service: [dropbear]
BR2_PACKAGE_DROPBEAR=y
BR2_PACKAGE_DROPBEAR_DISABLE_REVERSEDNS=y

# Service: [vsftpd]
BR2_PACKAGE_VSFTPD=y

# Service: [pwswd]
BR2_PACKAGE_PWSWD=y
BR2_PACKAGE_PWSWD_PLATFORM="gcw0"

# Service: [lowpowd]
BR2_PACKAGE_LOWPOWD=y

# System: [kmod]
BR2_PACKAGE_KMOD=y
BR2_PACKAGE_KMOD_TOOLS=y

# System: [ntp]
# BR2_PACKAGE_NTP=y
# BR2_PACKAGE_NTP_NTPDATE=y
# BR2_PACKAGE_NTP_NTPDC=y
# BR2_PACKAGE_NTP_NTPQ=y
# BR2_PACKAGE_NTP_TICKADJ=y

# System: [util_linux]
BR2_PACKAGE_UTIL_LINUX_BINARIES=y
BR2_PACKAGE_UTIL_LINUX_PARTX=y

# System: [unlockvt]
BR2_PACKAGE_UNLOCKVT=y

# Shells
BR2_PACKAGE_BAR=y
BR2_PACKAGE_DIALOG=y
BR2_PACKAGE_FILE=y
BR2_PACKAGE_LOCKFILE_PROGS=y
BR2_PACKAGE_NANO=y
BR2_PACKAGE_PV=y
BR2_PACKAGE_RSYNC=y
BR2_PACKAGE_SCREEN=y
BR2_PACKAGE_SED=y
BR2_PACKAGE_WGET=y
BR2_PACKAGE_NCURSES=y
BR2_PACKAGE_NCURSES_WCHAR=y
BR2_PACKAGE_NCURSES_ADDITIONAL_TERMINFO="s/st-256color"

# Compression
BR2_PACKAGE_BZIP2=y
BR2_PACKAGE_P7ZIP=y
BR2_PACKAGE_UNRAR=y
BR2_PACKAGE_UNRAR_SMP=n

# Audios 
BR2_PACKAGE_ALSA_UTILS=y
BR2_PACKAGE_ALSA_UTILS_AMIDI=y
BR2_PACKAGE_ALSA_UTILS_AMIXER=y
BR2_PACKAGE_ALSA_UTILS_APLAY=y
BR2_PACKAGE_ALSA_UTILS_ACONNECT=y
BR2_PACKAGE_ALSA_UTILS_APLAYMIDI=y
BR2_PACKAGE_ALSA_UTILS_ARECORDMIDI=y
BR2_PACKAGE_ALSA_UTILS_ASEQDUMP=y
BR2_PACKAGE_ALSA_UTILS_ASEQNET=y
BR2_PACKAGE_ALSA_VOLUME=y
BR2_PACKAGE_FLAC=y
BR2_PACKAGE_FLUIDSYNTH=y
BR2_PACKAGE_FLUIDSYNTH1=y
BR2_PACKAGE_LIBAIO=y
BR2_PACKAGE_LIBAO=y
BR2_PACKAGE_LIBMAD=y
BR2_PACKAGE_LIBSNDFILE=y
BR2_PACKAGE_MODPLUGTOOLS=y
BR2_PACKAGE_MPG123=y
BR2_PACKAGE_OPENAL=y
BR2_PACKAGE_OPUS_FIXED_POINT=y
BR2_PACKAGE_OPUSFILE=y
BR2_PACKAGE_SPEEX=y
BR2_PACKAGE_TAGLIB=y
BR2_PACKAGE_TREMOR=y

# Graphics
BR2_PACKAGE_ETNA_VIV=y
BR2_PACKAGE_ETNA_VIV_ABIV4=y
BR2_PACKAGE_GLM=y
BR2_PACKAGE_LIBJPEG8=y
BR2_PACKAGE_LIBPNG14=y
BR2_PACKAGE_LIBUNGIF=y
BR2_PACKAGE_MESA3D_ETNA_VIV=y
BR2_PACKAGE_PIXMAN=y
BR2_PACKAGE_LIBTHEORA=y

# Game engines: [sdl]
BR2_PACKAGE_SDL_GFX=y
BR2_PACKAGE_SDL_IMAGE_GIF=y
BR2_PACKAGE_SDL_IMAGE_TARGA=y
BR2_PACKAGE_SDL_IMAGE_XPM=y
BR2_PACKAGE_SDL_NET=y
BR2_PACKAGE_SDL_SOUND=y
BR2_PACKAGE_TIMIDITY_INSTRUMENTS=y

# Game engines: [sdl2]
BR2_PACKAGE_SDL2_IMAGE=y
BR2_PACKAGE_SDL2_IMAGE_GIF=y
BR2_PACKAGE_SDL2_IMAGE_JPEG=y
BR2_PACKAGE_SDL2_IMAGE_PNG=y
BR2_PACKAGE_SDL2_IMAGE_XPM=y
BR2_PACKAGE_SDL2_MIXER=y
BR2_PACKAGE_SDL2_NET=y
BR2_PACKAGE_SDL2_TTF=y

# Game engines: Others
# BR2_PACKAGE_ALLEGRO=y
# BR2_PACKAGE_BENNUGD=y
# BR2_PACKAGE_LOVE2D=y

# Monitoring
BR2_PACKAGE_XINETD=y
BR2_PACKAGE_FBGRAB=y
BR2_PACKAGE_HTOP=y
BR2_PACKAGE_MEMSTAT=y

# Debugging
# BR2_PTHREAD_DEBUG=y
# BR2_PACKAGE_BWM_NG=y
# BR2_PACKAGE_DHCPDUMP=y
# BR2_PACKAGE_DMALLOC=y
# BR2_PACKAGE_DSTAT=y
# BR2_PACKAGE_EVTEST=y
# BR2_PACKAGE_I2C_TOOLS=y
# BR2_PACKAGE_LINUX_TOOLS_PERF=y
# BR2_PACKAGE_NETCAT=y
# BR2_PACKAGE_OPROFILE=y
# BR2_PACKAGE_STRACE=y
# BR2_PACKAGE_STRESS=y
# BR2_PACKAGE_TCPDUMP=y

# Testing
# BR2_PACKAGE_LINUX_CONSOLE_TOOLS=y
# BR2_PACKAGE_LINUX_CONSOLE_TOOLS_JOY=y
# BR2_PACKAGE_LINUX_CONSOLE_TOOLS_FF=y

# Supports
BR2_PACKAGE_LIBCONFUSE=y
BR2_PACKAGE_LIBOPK=y
BR2_PACKAGE_LIBSHAKE=y
BR2_PACKAGE_LIBXDGMIME=y
BR2_PACKAGE_ICU=y

# Supports: File systems
BR2_PACKAGE_DOSFSTOOLS=y
BR2_PACKAGE_DOSFSTOOLS_FSCK_FAT=y
BR2_PACKAGE_E2FSPROGS=y
BR2_PACKAGE_E2FSPROGS_RESIZE2FS=y
BR2_PACKAGE_EXFAT=y
BR2_PACKAGE_NTFS_3G=y
BR2_PACKAGE_PHYSFS=y
BR2_PACKAGE_LIBSYSFS=y

# Scripting: [python]
BR2_PACKAGE_PYTHON=y
BR2_PACKAGE_PYTHON_CURSES=y
BR2_PACKAGE_PYTHON_PYEXPAT=y
BR2_PACKAGE_PYTHON_READLINE=y
BR2_PACKAGE_PYTHON_URLLIB3=y
BR2_PACKAGE_PYTHON_SQLITE=y
BR2_PACKAGE_PYTHON_ZLIB=y
BR2_PACKAGE_PYTHON_PYGAME=y
BR2_PACKAGE_PYTHON_PYGAME_FONT=y
BR2_PACKAGE_PYTHON_PYGAME_IMAGE=y
BR2_PACKAGE_PYTHON_PYGAME_MIXER=y
BR2_PACKAGE_PYTHON_PYGAME_MIXER_MUSIC=y
BR2_PACKAGE_PYTHON_SSL=y

# Network
# BR2_PACKAGE_AVAHI=y
# BR2_PACKAGE_AVAHI_DAEMON=y
# BR2_PACKAGE_HOSTAPD=y
# BR2_PACKAGE_HOSTAPD_EAP=y
# BR2_PACKAGE_HOSTAPD_WPS=y
# BR2_PACKAGE_IW=y
# BR2_PACKAGE_WIRELESS_TOOLS=y
# BR2_PACKAGE_WPA_SUPPLICANT=y
# BR2_PACKAGE_WPA_SUPPLICANT_AP_SUPPORT=y
# BR2_PACKAGE_WPA_SUPPLICANT_WPS=y
# BR2_PACKAGE_WPA_SUPPLICANT_CLI=y
# BR2_PACKAGE_WPA_SUPPLICANT_PASSPHRASE=y

# OPK: [gmenu2x]
BR2_PACKAGE_GMENU2X=y
BR2_PACKAGE_GMENU2X_PLATFORM="rg350m"
BR2_PACKAGE_GMENU2X_SHOW_CLOCK=y
BR2_PACKAGE_GMENU2X_WIDTH="640"
BR2_PACKAGE_GMENU2X_HEIGHT="480"
BR2_PACKAGE_GMENU2X_DEFAULT_FALLBACK_FONTS=",{\"/usr/share/fonts/dejavu/DejaVuSansCondensed.ttf\",26}"

# OPKs: [commander]
BR2_PACKAGE_COMMANDER=y
BR2_PACKAGE_COMMANDER_AUTOSCALE="0"
BR2_PACKAGE_COMMANDER_WIDTH="320"
BR2_PACKAGE_COMMANDER_HEIGHT="240"
BR2_PACKAGE_COMMANDER_PPU_X="2"
BR2_PACKAGE_COMMANDER_PPU_Y="2"
BR2_PACKAGE_COMMANDER_FONTS="{\"/usr/share/fonts/dejavu/DejaVuSansCondensed.ttf\",10}"
BR2_PACKAGE_COMMANDER_OPK_NAME="commander-rg350m"

# OPKs: Utilities
BR2_PACKAGE_O2XIV=y
BR2_PACKAGE_OD_PASSWD_CONFIG=y
BR2_PACKAGE_PYCLOCK=y

# OPKs: Others
# BR2_PACKAGE_BLOCKATTACK=y
# BR2_PACKAGE_DEVILUTIONX=y
# BR2_PACKAGE_GLUTEXTO=y
# BR2_PACKAGE_HOCOSLAMFY=y
# BR2_PACKAGE_PCSX4ALL=y
# BR2_PACKAGE_POCKESNES=y

# Dropping
# BR2_PACKAGE_FMTOOLS=y
# BR2_PACKAGE_LUAJIT=y
# BR2_PACKAGE_OPENSSH=y
# BR2_PACKAGE_TSLIB=y
```
